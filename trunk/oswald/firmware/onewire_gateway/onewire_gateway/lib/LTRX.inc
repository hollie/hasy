;;*****************************************************************************
;;*****************************************************************************
;;  FILENAME:   LTRX.inc
;;  Version: 5.2, Updated on 2008/6/23 at 12:26:23
;;  Generated by PSoC Designer ???
;;
;;  DESCRIPTION:  Assembler declarations for the UART user module for the
;;                22/24/25/26/27xxx PSoC family of devices.
;;-----------------------------------------------------------------------------
;;  Copyright (c) Cypress MicroSystems 2000-2003. All Rights Reserved.
;;*****************************************************************************
;;*****************************************************************************

;--------------------------------------------------
; Constants for LTRX API's
;--------------------------------------------------

;mask value for global int reg bit for TX instance
LTRX_TX_INT_MASK:                            equ 0x40
LTRX_TX_INT_REG:                             equ 0x0e1  ;TX interrupt address
LTRX_RX_INT_MASK:                            equ 0x80  ;mask value for global int reg bit for RX instance
LTRX_RX_INT_REG:                             equ 0x0e1  ;RX interrupt address

LTRX_RXBUF_ENABLE:                           equ 1

; Interrupt control masks
LTRX_ENABLE_RX_INT:                          equ 0x01
LTRX_DISABLE_RX_INT:                         equ 0x00
LTRX_ENABLE_TX_INT:                          equ 0x02
LTRX_DISABLE_TX_INT:                         equ 0x00

LTRX_INT_MODE_TX_REG_EMPTY:                  equ 0x00
LTRX_INT_MODE_TX_COMPLETE:                   equ 0x01

LTRX_RX_IGNORE_BELOW:                        equ 0x20
LTRX_RX_BUFFER_SIZE:                         equ 0x10
LTRX_CMD_TERM:                               equ 0xd
LTRX_DELIMITER:                              equ 0x20
LTRX_BACKSPACE_ENABLE:                       equ 0x0

;;;;;;;;;;;;;;;;;;;;;;;;;;;;;;;;;;;;;;;;;;;;;
;       WARNING WARNING WARNING
; The following equates are for backwards
; compatibility only and should not be used
; for new designs.
;;;;;;;;;;;;;;;;;;;;;;;;;;;;;;;;;;;;;;;;;;;;;

;------------------------------------
;  Parity masks
;------------------------------------
UART_PARITY_NONE:       equ   00h
UART_PARITY_EVEN:       equ   02h
UART_PARITY_ODD:        equ   06h

;------------------------------------
;  TX Status Register masks
;------------------------------------
UART_TX_COMPLETE:       equ   20h
UART_TX_BUFFER_EMPTY:   equ   10h

;------------------------------------
;  RX Status Register masks
;------------------------------------
UART_RX_ACTIVE:         equ   10h
UART_RX_COMPLETE:       equ   08h
UART_RX_PARITY_ERROR:   equ   80h
UART_RX_OVERRUN_ERROR:  equ   40h
UART_RX_FRAMING_ERROR:  equ   20h
UART_RX_NO_ERROR:       equ   E0h
;;;;;;;;;;;;;;;;;;;;;;;;;;;;;;;;;;;;;;;;;;;;;
;             END WARNING
;;;;;;;;;;;;;;;;;;;;;;;;;;;;;;;;;;;;;;;;;;;;;



;------------------------------------
;  Parity masks
;------------------------------------
LTRX_PARITY_NONE:                       equ   00h
LTRX_PARITY_EVEN:                       equ   02h
LTRX_PARITY_ODD:                        equ   06h

;------------------------------------
;  TX Status Register masks
;------------------------------------
LTRX_TX_COMPLETE:                       equ   20h
LTRX_TX_BUFFER_EMPTY:                   equ   10h

;------------------------------------
;  RX Status Register masks
;------------------------------------
LTRX_RX_ACTIVE:                         equ   10h
LTRX_RX_COMPLETE:                       equ   08h
LTRX_RX_REG_FULL:                       equ   08h
LTRX_RX_PARITY_ERROR:                   equ   80h
LTRX_RX_OVERRUN_ERROR:                  equ   40h
LTRX_RX_FRAMING_ERROR:                  equ   20h
LTRX_RX_ERROR:                          equ   E0h
LTRX_RX_ENABLE:                         equ   01h

LTRX_RX_BUF_ERROR:                      equ   F0h  ; Mask for any Rx that may occur.
LTRX_RX_BUF_OVERRUN:                    equ   10h  ; This indicates the software buffer has
                                                        ; been over run.
LTRX_RX_BUF_CMDTERM:                    equ   01h  ; Command terminator has been received.

LTRX_RX_NO_DATA:                        equ   01h
LTRX_RX_NO_ERROR:                       equ   E0h


;--------------------------------------------------
; Registers Address Constants for LTRX
;--------------------------------------------------
;---------------------------------
;  Registers used by TX
;---------------------------------
LTRX_TX_CONTROL_REG:    equ 3bh            ; Control register
LTRX_TX_SHIFT_REG:  equ 38h               ; TX Shift Register register
LTRX_TX_BUFFER_REG: equ 39h               ; TX Buffer Register
LTRX_TX_FUNC_REG:   equ 38h             ; Function register
LTRX_TX_INPUT_REG:  equ 39h             ; Input register
LTRX_TX_OUTPUT_REG: equ 3ah             ; Output register

;---------------------------------
;  Registers used by RX
;---------------------------------
LTRX_RX_CONTROL_REG:    equ 3fh            ; Control register
LTRX_RX_SHIFT_REG:  equ 3ch               ; RX Shift Register register
LTRX_RX_BUFFER_REG: equ 3eh               ; RX Buffer Register
LTRX_RX_FUNC_REG:   equ 3ch             ; Function register
LTRX_RX_INPUT_REG:  equ 3dh             ; Input register
LTRX_RX_OUTPUT_REG: equ 3eh             ; Output register

; end of file LTRX.inc
