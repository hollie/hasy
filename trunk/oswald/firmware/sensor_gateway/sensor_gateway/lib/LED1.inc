;;*****************************************************************************
;;*****************************************************************************
;;  FILENAME:   LED1.inc
;;  Version: 1.2, Updated on 2009/10/9 at 10:6:29
;;  Generated by PSoC Designer 5.0.1127.0
;;
;;  DESCRIPTION:  Assembler declarations for the LED user module interface.
;;-----------------------------------------------------------------------------
;;  Copyright (c) Cypress Semiconductor 2009. All Rights Reserved.
;;*****************************************************************************
;;*****************************************************************************

include "m8c.inc"

LED1_Port:      equ   0x3


LED1_PortDR:    equ   PRT3DR

LED1_PinMask:   equ  0x80

LED1_Drive:     equ   0

LED1_ON:        equ   0
LED1_OFF:       equ   1

;------------------------------------------------------
;  Register Address Constants for  LED1
;------------------------------------------------------

;------------------------------------------------------
;  Macros for  LED1
;------------------------------------------------------





; end of file LED1.inc
