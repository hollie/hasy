;;*****************************************************************************
;;*****************************************************************************
;;  FILENAME:   UART_IN.inc
;;  Version: 5.2, Updated on 2009/10/23 at 10:13:12
;;  Generated by PSoC Designer 5.0.1127.0
;;
;;  DESCRIPTION:  Assembler declarations for the UART user module.
;;-----------------------------------------------------------------------------
;;  Copyright (c) Cypress Semiconductor 2009. All Rights Reserved.
;;*****************************************************************************
;;*****************************************************************************

;--------------------------------------------------
; Constants for UART_IN API's
;--------------------------------------------------

;mask value for global int reg bit for TX instance
UART_IN_TX_INT_MASK:                         equ 0x04
UART_IN_TX_INT_REG:                          equ 0x0e1  ;TX interrupt address
UART_IN_RX_INT_MASK:                         equ 0x08  ;mask value for global int reg bit for RX instance
UART_IN_RX_INT_REG:                          equ 0x0e1  ;RX interrupt address

UART_IN_RXBUF_ENABLE:                        equ 1

; Interrupt control masks
UART_IN_ENABLE_RX_INT:                       equ 0x01
UART_IN_DISABLE_RX_INT:                      equ 0x00
UART_IN_ENABLE_TX_INT:                       equ 0x02
UART_IN_DISABLE_TX_INT:                      equ 0x00

UART_IN_INT_MODE_TX_REG_EMPTY:               equ 0x00
UART_IN_INT_MODE_TX_COMPLETE:                equ 0x01

UART_IN_RX_IGNORE_BELOW:                     equ 0x1
UART_IN_RX_BUFFER_SIZE:                      equ 0x10
UART_IN_CMD_TERM:                            equ 0x2a
UART_IN_DELIMITER:                           equ 0x0
UART_IN_BACKSPACE_ENABLE:                    equ 0x0

;;;;;;;;;;;;;;;;;;;;;;;;;;;;;;;;;;;;;;;;;;;;;
;       WARNING WARNING WARNING
; The following equates are for backwards
; compatibility only and should not be used
; for new designs.
;;;;;;;;;;;;;;;;;;;;;;;;;;;;;;;;;;;;;;;;;;;;;

;------------------------------------
;  Parity masks
;------------------------------------
UART_PARITY_NONE:       equ   00h
UART_PARITY_EVEN:       equ   02h
UART_PARITY_ODD:        equ   06h

;------------------------------------
;  TX Status Register masks
;------------------------------------
UART_TX_COMPLETE:       equ   20h
UART_TX_BUFFER_EMPTY:   equ   10h

;------------------------------------
;  RX Status Register masks
;------------------------------------
UART_RX_ACTIVE:         equ   10h
UART_RX_COMPLETE:       equ   08h
UART_RX_PARITY_ERROR:   equ   80h
UART_RX_OVERRUN_ERROR:  equ   40h
UART_RX_FRAMING_ERROR:  equ   20h
UART_RX_NO_ERROR:       equ   E0h
;;;;;;;;;;;;;;;;;;;;;;;;;;;;;;;;;;;;;;;;;;;;;
;             END WARNING
;;;;;;;;;;;;;;;;;;;;;;;;;;;;;;;;;;;;;;;;;;;;;



;------------------------------------
;  Parity masks
;------------------------------------
UART_IN_PARITY_NONE:                    equ   00h
UART_IN_PARITY_EVEN:                    equ   02h
UART_IN_PARITY_ODD:                     equ   06h

;------------------------------------
;  TX Status Register masks
;------------------------------------
UART_IN_TX_COMPLETE:                    equ   20h
UART_IN_TX_BUFFER_EMPTY:                equ   10h

;------------------------------------
;  RX Status Register masks
;------------------------------------
UART_IN_RX_ACTIVE:                      equ   10h
UART_IN_RX_COMPLETE:                    equ   08h
UART_IN_RX_REG_FULL:                    equ   08h
UART_IN_RX_PARITY_ERROR:                equ   80h
UART_IN_RX_OVERRUN_ERROR:               equ   40h
UART_IN_RX_FRAMING_ERROR:               equ   20h
UART_IN_RX_ERROR:                       equ   E0h
UART_IN_RX_ENABLE:                      equ   01h

UART_IN_RX_BUF_ERROR:                   equ   F0h  ; Mask for any Rx that may occur.
UART_IN_RX_BUF_OVERRUN:                 equ   10h  ; This indicates the software buffer has
                                                        ; been over run.
UART_IN_RX_BUF_CMDTERM:                 equ   01h  ; Command terminator has been received.

UART_IN_RX_NO_DATA:                     equ   01h
UART_IN_RX_NO_ERROR:                    equ   E0h


;--------------------------------------------------
; Registers Address Constants for UART_IN
;--------------------------------------------------
;---------------------------------
;  Registers used by TX
;---------------------------------
UART_IN_TX_CONTROL_REG: equ 2bh            ; Control register
UART_IN_TX_SHIFT_REG:   equ 28h               ; TX Shift Register register
UART_IN_TX_BUFFER_REG:  equ 29h               ; TX Buffer Register
UART_IN_TX_FUNC_REG:    equ 28h         ; Function register
UART_IN_TX_INPUT_REG:   equ 29h            ; Input register
UART_IN_TX_OUTPUT_REG:  equ 2ah           ; Output register

;---------------------------------
;  Registers used by RX
;---------------------------------
UART_IN_RX_CONTROL_REG: equ 2fh            ; Control register
UART_IN_RX_SHIFT_REG:   equ 2ch               ; RX Shift Register register
UART_IN_RX_BUFFER_REG:  equ 2eh               ; RX Buffer Register
UART_IN_RX_FUNC_REG:    equ 2ch         ; Function register
UART_IN_RX_INPUT_REG:   equ 2dh            ; Input register
UART_IN_RX_OUTPUT_REG:  equ 2eh           ; Output register

; end of file UART_IN.inc
