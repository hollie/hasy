;;*****************************************************************************
;;*****************************************************************************
;;  FILENAME: Ticker.inc
;;   Version: 2.5, Updated on 2009/10/15 at 17:11:37
;;  Generated by PSoC Designer 5.0.1127.0
;;
;;  DESCRIPTION: Assembler declarations for the Counter16 user module interface
;;-----------------------------------------------------------------------------
;;  Copyright (c) Cypress Semiconductor 2009. All Rights Reserved.
;;*****************************************************************************
;;*****************************************************************************

include "m8c.inc"


;--------------------------------------------------
; Constants for Ticker API's.
;--------------------------------------------------

Ticker_CONTROL_REG_START_BIT:              equ 0x01    ; Control register start bit
Ticker_INT_REG:                            equ 0x0df
Ticker_INT_MASK:                           equ 0x08


;--------------------------------------------------
; Constants for Ticker user defined values
;--------------------------------------------------

Ticker_PERIOD:                             equ 0xffff
Ticker_COMPARE_VALUE:                      equ 0x1


;--------------------------------------------------
; Register Address Constants for Ticker
;--------------------------------------------------

Ticker_COUNTER_LSB_REG:                equ 0x48   ; DR0 Counter register
Ticker_COUNTER_MSB_REG:                equ 0x4c
Ticker_PERIOD_LSB_REG:                 equ 0x49   ; DR1 Period register
Ticker_PERIOD_MSB_REG:                 equ 0x4d
Ticker_COMPARE_LSB_REG:                equ 0x4a   ; DR2 CompareValue register
Ticker_COMPARE_MSB_REG:                equ 0x4e
Ticker_CONTROL_LSB_REG:                equ 0x4b   ; Control register
Ticker_CONTROL_MSB_REG:                equ 0x4f
Ticker_FUNC_LSB_REG:                   equ 0x48   ; Function register
Ticker_FUNC_MSB_REG:                   equ 0x4c
Ticker_INPUT_LSB_REG:                  equ 0x49   ; Input register
Ticker_INPUT_MSB_REG:                  equ 0x4d
Ticker_OUTPUT_LSB_REG:                 equ 0x4a   ; Output register
Ticker_OUTPUT_MSB_REG:                 equ 0x4e


;--------------------------------------------------
; Ticker Macro 'Functions'
;--------------------------------------------------

   macro Ticker_Start_M
   or    reg[Ticker_CONTROL_LSB_REG],  Ticker_CONTROL_REG_START_BIT
   endm

   macro Ticker_Stop_M
   and   reg[Ticker_CONTROL_LSB_REG], ~Ticker_CONTROL_REG_START_BIT
   endm

   macro Ticker_EnableInt_M
   M8C_EnableIntMask Ticker_INT_REG, Ticker_INT_MASK
   endm

   macro Ticker_DisableInt_M
   M8C_DisableIntMask Ticker_INT_REG, Ticker_INT_MASK
   endm


; end of file Ticker.inc

